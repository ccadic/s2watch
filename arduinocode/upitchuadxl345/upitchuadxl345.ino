
#include <Adafruit_GFX.h>    // Core graphics library
#include <Adafruit_ST7735.h> // Hardware-specific library for ST7735
#include <Adafruit_ST7789.h> // Hardware-specific library for ST7789

#include <SPI.h>
#include <Adafruit_Sensor.h>
#include <Adafruit_ADXL345_U.h>
#include <DS3231.h>

/*#include "WiFi.h" */

#include "droid40pt7b.h"


long previousMillis = 0;
long previousMillisTime = 0;
long previousMillisAlarm=0;
long previousMillisLowpower=0;
long previousMillisZedate=0;


long interval = 2000;
int a = 60;
int backlight = 1;

// modestatus
/*
  modestatus = 0  Normal mode
  modestatus = 1 set the time
  modestatus = 2 set the alarm
  
  
*/
int modestatus = 0; 

const unsigned char clockk [] PROGMEM = {
  // 'time, 16x16px
  0x00, 0x00, 0x03, 0xc0, 0x0f, 0xf0, 0x18, 0x18, 0x30, 0x0c, 0x21, 0x04, 0x61, 0x06, 0x61, 0x06, 
  0x61, 0x86, 0x60, 0x66, 0x20, 0x24, 0x30, 0x0c, 0x18, 0x18, 0x0f, 0xf0, 0x03, 0xc0, 0x00, 0x00
};

const unsigned char batt [] PROGMEM = {
  // 'fa-battery-0, 16x16px
  0x00, 0x00, 0x00, 0x00, 0x00, 0x00, 0x00, 0x00, 0xff, 0xfe, 0xff, 0xfe, 0xc0, 0x03, 0xc0, 0x03, 
  0xc0, 0x03, 0xc0, 0x03, 0xff, 0xfe, 0xff, 0xfe, 0x00, 0x00, 0x00, 0x00, 0x00, 0x00, 0x00, 0x00
};

const unsigned char batt1 [] PROGMEM = {
  // 'fa-battery-1, 16x16px
  0x00, 0x00, 0x00, 0x00, 0x00, 0x00, 0x00, 0x00, 0xff, 0xfe, 0xff, 0xfe, 0xd8, 0x03, 0xfc, 0x03, 
  0xfc, 0x03, 0xd8, 0x03, 0xff, 0xfe, 0xff, 0xfe, 0x00, 0x00, 0x00, 0x00, 0x00, 0x00, 0x00, 0x00
};

const unsigned char batt2 [] PROGMEM = {
  // 'fa-battery-2, 16x16px
  0x00, 0x00, 0x00, 0x00, 0x00, 0x00, 0x00, 0x00, 0xff, 0xfe, 0xff, 0xfe, 0xdf, 0x03, 0xff, 0x03, 
  0xff, 0x03, 0xdf, 0x03, 0xff, 0xfe, 0xff, 0xfe, 0x00, 0x00, 0x00, 0x00, 0x00, 0x00, 0x00, 0x00
};

const unsigned char batt3[] PROGMEM = {
  // 'fa-battery-3, 16x16px
  0x00, 0x00, 0x00, 0x00, 0x00, 0x00, 0x00, 0x00, 0xff, 0xfe, 0xff, 0xfe, 0xdf, 0xc3, 0xff, 0xc3, 
  0xff, 0xc3, 0xdf, 0xc3, 0xff, 0xfe, 0xff, 0xfe, 0x00, 0x00, 0x00, 0x00, 0x00, 0x00, 0x00, 0x00
};

const unsigned char batt4 [] PROGMEM = {
  // 'fa-battery-4, 16x16px
  0x00, 0x00, 0x00, 0x00, 0x00, 0x00, 0x00, 0x00, 0xff, 0xfe, 0xff, 0xfe, 0xdf, 0xfb, 0xff, 0xfb, 
  0xff, 0xfb, 0xdf, 0xfb, 0xff, 0xfe, 0xff, 0xfe, 0x00, 0x00, 0x00, 0x00, 0x00, 0x00, 0x00, 0x00
};

const unsigned char wifii [] PROGMEM = {
  // 'fa-wifi, 16x16px
  0x00, 0x00, 0x00, 0x00, 0x03, 0xc0, 0x1f, 0xf8, 0x7e, 0x7e, 0xf0, 0x0f, 0x43, 0xc2, 0x0f, 0xf0, 
  0x1e, 0x78, 0x18, 0x18, 0x01, 0x80, 0x03, 0xc0, 0x03, 0xc0, 0x01, 0x80, 0x00, 0x00, 0x00, 0x00
};

const unsigned char belli [] PROGMEM = {
  // 'fa-bell, 16x16px
  0x01, 0x80, 0x01, 0x80, 0x07, 0xe0, 0x0f, 0xf0, 0x1f, 0xf8, 0x1f, 0xf8, 0x1f, 0xf8, 0x1f, 0xf8, 
  0x1f, 0xf8, 0x1f, 0xf8, 0x3f, 0xfc, 0x7f, 0xfe, 0x7f, 0xfe, 0x00, 0x00, 0x03, 0xc0, 0x01, 0x80
};


const unsigned char morpheans [] PROGMEM = {
  // 'logo-2, 172x320px
  0xff, 0xff, 0xff, 0xff, 0xff, 0xff, 0xff, 0xff, 0xff, 0xff, 0xff, 0xff, 0xff, 0xff, 0xff, 0xff, 
  0xff, 0xff, 0xff, 0xff, 0xff, 0xf0, 0xff, 0xff, 0xff, 0xff, 0xff, 0xff, 0xff, 0xff, 0xff, 0xff, 
  0xff, 0xff, 0xff, 0xff, 0xff, 0xff, 0xff, 0xff, 0xff, 0xff, 0xff, 0xf0, 0xff, 0xff, 0xff, 0xff, 
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  0xff, 0xff, 0xff, 0xff, 0xff, 0xff, 0xff, 0xff, 0xff, 0xff, 0xff, 0xff, 0xff, 0xff, 0xff, 0xf0
};

const unsigned char payETH [] PROGMEM = {  // QR CODE to send me ETH
  // 'PayETHQRCODE, 170x168px
  0x00, 0x00, 0x00, 0x00, 0x00, 0x00, 0x00, 0x00, 0x00, 0x00, 0x00, 0x00, 0x00, 0x00, 0x00, 0x00, 
  0x00, 0x00, 0x00, 0x00, 0x00, 0x00, 0x00, 0x00, 0x00, 0x00, 0x00, 0x00, 0x00, 0x00, 0x00, 0x00, 
  0x00, 0x00, 0x00, 0x00, 0x00, 0x00, 0x00, 0x00, 0x00, 0x00, 0x00, 0x00, 0x00, 0x00, 0x00, 0x00, 
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  0x00, 0x00, 0x00, 0x00, 0x00, 0x00, 0x00, 0x00, 0x00, 0x00, 0x00, 0x00, 0x00, 0x00, 0x00, 0x00
};


#define TFT_DC    14
#define TFT_RST  16 
#define TFT_CS    10 // only for displays with CS pin
#define TFT_MOSI  11   // for hardware SPI data pin (all of available pins)
#define TFT_SCLK  12   // for hardware SPI sclk pin (all of available pins)

#define LEDA 3  // Powering the LED display
#define V3D 4  // Powering the LED display

#define SDA_PIN 41
#define SCL_PIN 40

// Define buttons
#define BUT1 6
#define BUT2 7
#define BUT3 8
#define BUT4 9


// OR for the ST7789-based displays, we will use this call
Adafruit_ST7789 tft = Adafruit_ST7789(TFT_CS, TFT_DC, TFT_MOSI, TFT_SCLK, TFT_RST);




/* Assign a unique ID to this sensor at the same time */
Adafruit_ADXL345_Unified accel = Adafruit_ADXL345_Unified(12345);


 

DS3231 clock1;

bool century = false;
bool h12Flag;
bool pmFlag;

byte alarmDay, alarmHour, alarmMinute, alarmSecond, alarmBits;
bool alarmDy, alarmH12Flag, alarmPmFlag;


// For setting the date and time
byte year;
byte month;
byte date;
byte dOW;
byte hour;
byte minute;
byte second;


byte alarmhour;
byte alarmminute;
byte alarmdate;




// vibration motor
int motorPin = 5;    // vibration motor digital pin D15

// Battery cnx
int ADC_pin = 17; // GPIO 17 is Now AN Input 1
const int MAX_ANALOG_VAL = 4095;
const float MAX_BATTERY_VOLTAGE = 4.2; // Max LiPoly voltage of a 3.7 battery is 4.2

float vout = 0.0;
float vin = 0.0;
float R1 = 98900.0;
float R2 =  98900.0;
int value = 0;


void displaySensorDetails(void)
{
  sensor_t sensor;
  accel.getSensor(&sensor);
  Serial.println("------------------------------------");
  Serial.print  ("Sensor:       "); Serial.println(sensor.name);
  Serial.print  ("Driver Ver:   "); Serial.println(sensor.version);
  Serial.print  ("Unique ID:    "); Serial.println(sensor.sensor_id);
  Serial.print  ("Max Value:    "); Serial.print(sensor.max_value); Serial.println(" m/s^2");
  Serial.print  ("Min Value:    "); Serial.print(sensor.min_value); Serial.println(" m/s^2");
  Serial.print  ("Resolution:   "); Serial.print(sensor.resolution); Serial.println(" m/s^2");  
  Serial.println("------------------------------------");
  Serial.println("");
  delay(500);
}

void displayDataRate(void)
{
  Serial.print  ("Data Rate:    "); 
  
  switch(accel.getDataRate())
  {
    case ADXL345_DATARATE_3200_HZ:
      Serial.print  ("3200 "); 
      break;
    case ADXL345_DATARATE_1600_HZ:
      Serial.print  ("1600 "); 
      break;
    case ADXL345_DATARATE_800_HZ:
      Serial.print  ("800 "); 
      break;
    case ADXL345_DATARATE_400_HZ:
      Serial.print  ("400 "); 
      break;
    case ADXL345_DATARATE_200_HZ:
      Serial.print  ("200 "); 
      break;
    case ADXL345_DATARATE_100_HZ:
      Serial.print  ("100 "); 
      break;
    case ADXL345_DATARATE_50_HZ:
      Serial.print  ("50 "); 
      break;
    case ADXL345_DATARATE_25_HZ:
      Serial.print  ("25 "); 
      break;
    case ADXL345_DATARATE_12_5_HZ:
      Serial.print  ("12.5 "); 
      break;
    case ADXL345_DATARATE_6_25HZ:
      Serial.print  ("6.25 "); 
      break;
    case ADXL345_DATARATE_3_13_HZ:
      Serial.print  ("3.13 "); 
      break;
    case ADXL345_DATARATE_1_56_HZ:
      Serial.print  ("1.56 "); 
      break;
    case ADXL345_DATARATE_0_78_HZ:
      Serial.print  ("0.78 "); 
      break;
    case ADXL345_DATARATE_0_39_HZ:
      Serial.print  ("0.39 "); 
      break;
    case ADXL345_DATARATE_0_20_HZ:
      Serial.print  ("0.20 "); 
      break;
    case ADXL345_DATARATE_0_10_HZ:
      Serial.print  ("0.10 "); 
      break;
    default:
      Serial.print  ("???? "); 
      break;
  }  
  Serial.println(" Hz");  
}

void displayRange(void)
{
  Serial.print  ("Range:         +/- "); 
  
  switch(accel.getRange())
  {
    case ADXL345_RANGE_16_G:
      Serial.print  ("16 "); 
      break;
    case ADXL345_RANGE_8_G:
      Serial.print  ("8 "); 
      break;
    case ADXL345_RANGE_4_G:
      Serial.print  ("4 "); 
      break;
    case ADXL345_RANGE_2_G:
      Serial.print  ("2 "); 
      break;
    default:
      Serial.print  ("?? "); 
      break;
  }  
  Serial.println(" g");  
}


void setup(void) {
  Serial.begin(115200);
  Serial.print(F("Hello! ST77xx TFT Test"));
  Wire.begin(SDA_PIN, SCL_PIN); // SDA, SCL

// Vibration motor
  pinMode(motorPin, OUTPUT );

/*
// wifi stuff 
    // Set WiFi to station mode and disconnect from an AP if it was previously connected
    WiFi.mode(WIFI_STA);
    WiFi.disconnect();
    delay(100);
  */
    
// PowerDisplay V3D
  pinMode(V3D, OUTPUT);
  digitalWrite(V3D, HIGH); // sets the digital pin 13 on
  delay(100);            // waits for a second/
// Backlite setup
  pinMode(LEDA, OUTPUT);
  digitalWrite(LEDA, HIGH); // sets the digital pin 13 on
  delay(100);            // waits for a second

// ADC
pinMode(ADC_pin, INPUT); 
  
  // OR use this initializer (uncomment) if using a 1.47" 172x320 TFT:
  digitalWrite(LEDA, LOW); // sets the digital pin 13 on
  tft.init(172, 320);           // Init ST7789 172x320


 

  // SPI speed defaults to SPI_DEFAULT_FREQ defined in the library, you can override it here
  // Note that speed allowable depends on chip and quality of wiring, if you go too fast, you
  // may end up with a black screen some times, or all the time.
  //tft.setSPISpeed(40000000);

  Serial.println(F("Initialized"));

  uint16_t time = millis();

    tft.setTextWrap(false);
    //tft.setRotation(1);
    tft.fillScreen(ST77XX_GREEN);
    tft.drawBitmap(0,0, morpheans, 172, 320, ST77XX_BLACK);
     digitalWrite(LEDA, HIGH); // sets the digital pin 13 on
 
  // time = millis() - time;

  //Serial.println(time, DEC);
  delay(1000);

  
  // tft print function!
  //tftPrintTest();
  //delay(1000);

 
  Serial.println("done");
  delay(1000);

  // set button
   pinMode(BUT1, INPUT);
   pinMode(BUT2, INPUT);
   pinMode(BUT3, INPUT);
   pinMode(BUT4, INPUT);
   

  // Set time ahd date
  /*      
        clock1.setClockMode(false);  // set to 24h
        //setClockMode(true); // set to 12h
        
        clock1.setYear(22); //
        clock1.setMonth(3);
        clock1.setDate(6);
        clock1.setDoW(7);
        clock1.setHour(13);
        clock1.setMinute(59);
        clock1.setSecond(0);

        */


  

  // display time
  for (int i=0; i<1; i++){
      
      tft.fillScreen(ST77XX_BLACK);
      tft.setTextWrap(false);
      //tft.setRotation(1);
      tft.setFont(&droid40pt7b); // specific fonts
      tft.setCursor(40, 80);
      tft.setTextColor(ST77XX_WHITE);
      tft.setTextSize(1);
   
      

  // Draw the too separated squares
     tft.fillRect(0, 0, 172, 320/2, ST77XX_GREEN);
     tft.fillRect(0, 320/2, 172, 320, ST77XX_BLACK);
     

  // Display a fake time
      tft.setCursor(50, 140);
      tft.setTextColor(ST77XX_BLACK);
      tft.setTextSize(2);
      tft.print(clock1.getHour(h12Flag, pmFlag), DEC);
       
  // Display a fake time
      tft.setCursor(50, 320/2+140);
      tft.setTextColor(ST77XX_GREEN);
      tft.setTextSize(2);
      tft.print(clock1.getMinute(), DEC);

  // Return to normal font
  tft.setFont();

  // Display the month and date
     tft.setCursor(5, 140);
     tft.setTextColor(ST77XX_BLACK);
     tft.setTextSize(2);
     tft.print(clock1.getMonth(century), DEC);
     tft.print("-");      
     tft.print(clock1.getDate(), DEC);

  // Display the year
     tft.setCursor(5, 170);
     tft.setTextColor(ST77XX_GREEN);
     tft.setTextSize(2);
     tft.print(2000+clock1.getYear(), DEC);
   
// Draw battery

  tft.drawBitmap(15,5, batt3, 16, 16, ST77XX_BLACK);
  tft.drawBitmap(140,5, wifii, 16, 16, ST77XX_BLACK);
  tft.drawBitmap(140,24, belli, 16, 16, ST77XX_BLACK);
   
   
  delay(1000);
  
  
  // Vibrate a bit
    digitalWrite(motorPin, HIGH);
    delay(1000);
    digitalWrite(motorPin, LOW);
    delay(1000);


  /*
  // Scan wifi SSID
      tft.fillScreen(ST77XX_BLACK);
      tft.setTextWrap(false);
      tft.setRotation(1);
      tft.fillScreen(ST77XX_BLACK);
      tft.setCursor(0, 30);
      tft.setTextColor(ST77XX_WHITE);
      tft.setTextSize(1);

   
    // WiFi.scanNetworks will return the number of networks found
    int n = WiFi.scanNetworks();
    Serial.println("scan done");
    if (n == 0) {
        tft.println("no networks found");
    } else {
        tft.print(n);
        tft.println(" networks found");
        for (int i = 0; i < n; ++i) {
            // Print SSID and RSSI for each network found
            tft.print(i + 1);
            tft.print(": ");
            tft.print(WiFi.SSID(i));
            tft.print(" (");
            tft.print(WiFi.RSSI(i));
            tft.print(")");
            tft.println((WiFi.encryptionType(i) == WIFI_AUTH_OPEN)?" ":"*");
            delay(10);
        }
    }
    tft.println("");

 
   
    delay(1000);

   */
 
  
  }
  


/* Initialise the sensor */
  if(!accel.begin())
  {
    /* There was a problem detecting the ADXL345 ... check your connections */
    Serial.println("Ooops, no ADXL345 detected ... Check your wiring!");
    while(1);
  }

  /* Set the range to whatever is appropriate for your project */
  accel.setRange(ADXL345_RANGE_16_G);
  // accel.setRange(ADXL345_RANGE_8_G);
  // accel.setRange(ADXL345_RANGE_4_G);
  // accel.setRange(ADXL345_RANGE_2_G);
  
  /* Display some basic information on this sensor */
  displaySensorDetails();
  
  /* Display additional settings (outside the scope of sensor_t) */
  displayDataRate();
  displayRange();
  Serial.println("");
  
  
}

void loop() {
 
 // Low power long previousMillisLowpower - auto power off to save energy after 60 sec.
     unsigned long currentMillisLowpower = millis();
    
    if (currentMillisLowpower - previousMillisLowpower > 60000) {
     previousMillisLowpower = currentMillisLowpower;
     backlight=0;
     
     }
    
 
 // Each minute , dipslay type
    if (modestatus == 0){

    trotteuse();
      
    unsigned long currentMillis = millis();
    
    if (currentMillis - previousMillis > 60000) {
     previousMillis = currentMillis;
     displayTime();
      
    }
    }

   // if modestatus = 2 SET ALARM DAY/DATE
   if (modestatus == 2){ 


  // We get the alarm from the chip (date hour)
     clock1.getA1Time(alarmDay, alarmHour, alarmMinute, alarmSecond, alarmBits, alarmDy, alarmH12Flag, alarmPmFlag);

    alarmhour = alarmHour;
    alarmminute = alarmMinute;
    alarmdate = alarmDay;
   

     unsigned long currentMillisAlarm = millis();
    
    if (currentMillisAlarm - previousMillisAlarm > 60000) {
     previousMillisAlarm = currentMillisAlarm;
     SetAlarm(alarmhour,alarmminute,alarmdate);
     }
    
    } 


   // if modestatus = 3 SET DAY/MONTH/YEAR
    if (modestatus == 3){ 
     // we show the time adjustment window

    unsigned long currentMillisZedate = millis();
    
    if (currentMillisZedate - previousMillisZedate > 60000) {
     previousMillisZedate = currentMillisZedate;

     year = clock1.getYear();
     month = clock1.getMonth(century);
     date = clock1.getDate();
     hour = clock1.getHour(h12Flag, pmFlag);
     minute = clock1.getMinute();

     //      adjustTime(clock1.getHour(h12Flag, pmFlag), clock1.getMinute(), clock1.getDate(), clock1.getMonth(century), clock1.getYear());     
     adjustDate(hour, minute, date, month, year);
     }

    } 

   

   // if modestatus = 1 SET HOUR/MIN DAY/DATE
   if (modestatus == 1){ 
     // we show the time adjustment window

    unsigned long currentMillisTime = millis();
    
    if (currentMillisTime - previousMillisTime > 60000) {
     previousMillisTime = currentMillisTime;

     year = clock1.getYear();
     month = clock1.getMonth(century);
     date = clock1.getDate();
     hour = clock1.getHour(h12Flag, pmFlag);
     minute = clock1.getMinute();

     //      adjustTime(clock1.getHour(h12Flag, pmFlag), clock1.getMinute(), clock1.getDate(), clock1.getMonth(century), clock1.getYear());     
     adjustTime(hour, minute, date, month, year);
     }

    } 



   // Get button 4 status
   if (digitalRead(BUT4)==HIGH){  // S4 button pressed

    if (backlight==1){
      backlight=0;
      delay(200);
      } else {
       backlight=1;
       delay(200); 
      }
      
    }

   // S2 button is to chage the modestatus
   if (digitalRead(BUT3)==HIGH){  // S2 button pressed change mode status

    modestatus = modestatus +1 ;
    if (modestatus >3){
      modestatus = 0;
      displayTime();
      }
    //clock1.getA1Time(alarmDay, alarmHour, alarmMinute, alarmSecond, alarmBits, alarmDy, alarmH12Flag, alarmPmFlag);
      
    }

    // If modestatus = 1 and S1 pressed then hour +1
    // If modestatus = 1 and S3 pressed then min +1

/*
     BUT1 6   BUT S3
     BUT2 7   BUT S1
     BUT3 8   BUT S2
     BUT4 9   BUT S4
*/




  if (digitalRead(BUT2)==HIGH && digitalRead(BUT1)==HIGH && modestatus == 1 ){  // BOth buttons pressed we change the year
    // we check if alarm is on if so we remove it, it not, we activate it.
 
    year = year +1;
      if (year > 30){ year = 1;
      }
    
     adjustDate(hour, minute, date, month, year);
     // and write to RTC      
     adjustRTC(hour, minute, date, month, year);
       
     
    }

   // update date days
   if (digitalRead(BUT2)==HIGH && modestatus == 3 ){  // S2 button pressed change mode status
    // we add hour +1 and refresh the display blue
     date = date +1;
      if (date > 31){ date = 1;
      }
    
     adjustDate(hour, minute, date, month, year);
     // and write to RTC      
     adjustRTC(hour, minute, date, month, year);
    }


   // update date days
   if (digitalRead(BUT1)==HIGH && modestatus == 3 ){  // S2 button pressed change mode status
    // we add hour +1 and refresh the display blue
     month = month +1;
      if (month > 12){ month = 1;
      }
    
     adjustDate(hour, minute, date, month, year);
     // and write to RTC      
     adjustRTC(hour, minute, date, month, year);
    }



   // update time hours
   if (digitalRead(BUT2)==HIGH && modestatus == 1 ){  // S2 button pressed change mode status
    // we add hour +1 and refresh the display blue
     hour = hour +1;
      if (hour > 23){ hour = 0;
      }
    
     adjustTime(hour, minute, date, month, year);
     // and write to RTC      
     adjustRTC(hour, minute, date, month, year);
    }


   // update time minutes
   if (digitalRead(BUT1)==HIGH && modestatus == 1 ){  // S2 button pressed change mode status
    // we add hour +1 and refresh the display blue
     minute = minute +1;
     if (minute > 59){ minute = 0;
      }
     adjustTime(hour, minute, date, month, year);
     // and write to RTC      
     adjustRTC(hour, minute, date, month, year);

    }


 // Activate or deactivate ALARM with BUT2 and BUT1 pressed at the same time from modestatus = 0 / We also remove the bell
   if (digitalRead(BUT2)==HIGH &&digitalRead(BUT1)==HIGH && modestatus == 0 ){  // BOth buttons pressed change alarm status
    // we check if alarm is on if so we remove it, it not, we activate it.
    // clock1.turnOnAlarm(1);

     if (clock1.checkAlarmEnabled(1)) {
       clock1.turnOffAlarm(1); // it was on, we put it off
           displayTime();


    } else 
    {
      clock1.turnOnAlarm(1);  // it was off , we activate
          displayTime();

      };
       
     
    }

 

 // update alarm time hours
   if (digitalRead(BUT2)==HIGH && modestatus == 2 ){  // S2 button pressed change mode status
    // we add hour +1 and refresh the display blue
     alarmhour = alarmhour +1;
      if (alarmhour > 23){ alarmhour = 0;
      }
    
     SetAlarm(alarmhour,alarmminute,alarmdate);
     // and write to RTC      
     adjustRTCalarm(alarmhour, alarmminute, alarmdate);
    }


   // update alarm time minutes
   if (digitalRead(BUT1)==HIGH && modestatus == 2 ){  // S2 button pressed change mode status
    // we add hour +1 and refresh the display blue
     alarmminute = alarmminute +1;
     if (alarmminute > 59){ alarmminute = 0;
      }
     SetAlarm(alarmhour,alarmminute,alarmdate);

     // and write to RTC      
     adjustRTCalarm(alarmhour, alarmminute, alarmdate);

    }

   // Set light on or off
   if (backlight == 1){
    digitalWrite(LEDA, HIGH); // sets the digital pin 13 on
   } else {
    digitalWrite(LEDA, LOW); 
    }
   

 
}

// SetAlarm(alarmhour,alarmminute,alarmdate);
void SetAlarm(int heure, int minut, int jour){ // function to set the alarm and store it into DS3231
  // We first show the display
  // byte alarmhour;
  // byte alarmminute;



  
  // Draw the too separated squares
     tft.setRotation(0);
     tft.fillRect(0, 0, 172, 320/2, ST77XX_RED);
     tft.fillRect(0, 320/2, 172, 320, ST77XX_BLACK);
     tft.setFont(&droid40pt7b); // specific fonts

  // Display hour 
      tft.setCursor(50, 140);
      tft.setTextColor(ST77XX_BLACK);
      tft.setTextSize(2);      
      if (heure<10){
        tft.print("0");
        }
  
      tft.print(heure, DEC);
       
  // Display minutes
      tft.setCursor(50, 320/2+140);
      tft.setTextColor(ST77XX_RED);
      tft.setTextSize(2);
      if (minut<10){
        tft.print("0");
        }
      tft.print(minut, DEC);

    // Return to normal font
      tft.setFont();
  
   // Debug display the modestatus
   /*
   tft.setCursor(137, 200);
     tft.setTextColor(ST77XX_RED);
     tft.setTextSize(2);
     tft.print(modestatus);
     tft.print("MS");    */


   tft.drawBitmap(140,24, belli, 16, 16, ST77XX_BLACK);  

  
  }

void displayTime(void){
// Draw the too separated squares
     tft.setRotation(0);
     tft.fillRect(0, 0, 172, 320/2, ST77XX_GREEN);
     tft.fillRect(0, 320/2, 172, 320, ST77XX_BLACK);
     tft.setFont(&droid40pt7b); // specific fonts

  // Display hour 
      tft.setCursor(50, 140);
      tft.setTextColor(ST77XX_BLACK);
      tft.setTextSize(2);      
      if (clock1.getHour(h12Flag, pmFlag)<10){
        tft.print("0");
        }
  
      tft.print(clock1.getHour(h12Flag, pmFlag), DEC);
       
  // Display minutes
      tft.setCursor(50, 320/2+140);
      tft.setTextColor(ST77XX_GREEN);
      tft.setTextSize(2);
      if (clock1.getMinute()<10){
        tft.print("0");
        }
      tft.print(clock1.getMinute(), DEC);

      

  // Return to normal font
  tft.setFont();

  // Display the month and date
     tft.setCursor(5, 140);
     tft.setTextColor(ST77XX_BLACK);
     tft.setTextSize(2);
     tft.print(clock1.getMonth(century), DEC);
     tft.print("-");      
     tft.print(clock1.getDate(), DEC);

  // Display the year
     tft.setCursor(5, 170);
     tft.setTextColor(ST77XX_GREEN);
     tft.setTextSize(2);
     tft.print(2000+clock1.getYear(), DEC);

  // Display the temp
   tft.setCursor(137, 170);
     tft.setTextColor(ST77XX_GREEN);
     tft.setTextSize(2);
     tft.print(clock1.getTemperature(), 0);
     tft.print("C");

  // Check if alarm 1 is enable
  if (clock1.checkAlarmEnabled(1)) {
    //Serial.print("enabled");
    // if yes, we show the icon
     tft.drawBitmap(140,24, belli, 16, 16, ST77XX_BLACK);
  }   

 

  // Debug display the modestatus
   /*
   tft.setCursor(137, 200);
     tft.setTextColor(ST77XX_RED);
     tft.setTextSize(2);
     tft.print(modestatus);
     tft.print("MS");       
    */
     
}



void adjustRTCalarm(int heure, int minut, int jour){

        // Set time ahd date for the alarm and set alarm on.
           clock1.setA1Time(7, heure, minut, 0, 0x0, true,false, false);
        // Turn on both alarms, with external interrupt
        clock1.turnOnAlarm(1);
     
}
        
void adjustRTC(int heure, int minut, int jour, int mois, int annee){

        // Set time ahd date
        clock1.setClockMode(false);  // set to 24h   
        clock1.setYear(annee); //
        clock1.setMonth(mois);
        clock1.setDate(jour);
        clock1.setDoW(7);
        clock1.setHour(heure);
        clock1.setMinute(minut);
        clock1.setSecond(0);
     
}


void adjustDate(int heure, int minut, int jour, int mois, int annee){
// Draw the too separated squares
     tft.setRotation(0);
     tft.fillRect(0, 0, 172, 320/2, ST77XX_CYAN);
     tft.fillRect(0, 320/2, 172, 320, ST77XX_BLACK);
  //   tft.setFont(&droid40pt7b); // specific fonts      

  // Return to normal font
  tft.setFont();

  // Display the month and date
     tft.setCursor(5, 140);
     tft.setTextColor(ST77XX_BLACK);
     tft.setTextSize(2);
     tft.print(mois, DEC);
     tft.print("-");      
     tft.print(jour, DEC);

  // Display the year
     tft.setCursor(5, 170);
     tft.setTextColor(ST77XX_CYAN);
     tft.setTextSize(2);
     tft.print(2000+annee, DEC);

     tft.drawBitmap(140,24, clockk, 16, 16, ST77XX_BLACK);

  // Debug display the modestatus
  /*
   tft.setCursor(137, 170);
     tft.setTextColor(ST77XX_CYAN);
     tft.setTextSize(2);
     tft.print(modestatus);
     tft.print("MS");    
    */
     
}


void adjustTime(int heure, int minut, int jour, int mois, int annee){
// Draw the too separated squares
     tft.setRotation(0);
     tft.fillRect(0, 0, 172, 320/2, ST77XX_CYAN);
     tft.fillRect(0, 320/2, 172, 320, ST77XX_BLACK);
     tft.setFont(&droid40pt7b); // specific fonts

  // Display hour 
      tft.setCursor(50, 140);
      tft.setTextColor(ST77XX_BLACK);
      tft.setTextSize(2);      
      if (heure<10){
        tft.print("0");
        }
  
      tft.print(heure, DEC);
       
  // Display minutes
      tft.setCursor(50, 320/2+140);
      tft.setTextColor(ST77XX_CYAN);
      tft.setTextSize(2);
      if (minut<10){
        tft.print("0");
        }
      tft.print(minut, DEC);

      

  // Return to normal font
  tft.setFont();

  // Display the month and date
     tft.setCursor(5, 140);
     tft.setTextColor(ST77XX_BLACK);
     tft.setTextSize(2);
     tft.print(mois, DEC);
     tft.print("-");      
     tft.print(jour, DEC);

  // Display the year
     tft.setCursor(5, 170);
     tft.setTextColor(ST77XX_CYAN);
     tft.setTextSize(2);
     tft.print(2000+annee, DEC);


     tft.drawBitmap(140,24, clockk, 16, 16, ST77XX_BLACK);

  // Debug display the modestatus
  /*
   tft.setCursor(137, 170);
     tft.setTextColor(ST77XX_CYAN);
     tft.setTextSize(2);
     tft.print(modestatus);
     tft.print("MS");    
    */
     
}

void checkVoltage(){
value = analogRead(ADC_pin);
vout = (value * 4.2)/6300.0;
vin = vout / (R2/(R1+R2));
if (vin < 0.09){
vin = 0.0;
}}


  void loopbackup() {
 // Loop to display something like the X Y Z axis of ADXL345
  
 /* Get a new sensor event */ 
  sensors_event_t event; 
  accel.getEvent(&event);


 tft.setTextWrap(false);
  tft.setRotation(0);
  tft.fillScreen(ST77XX_BLACK);
  tft.setCursor(0, 30);
  tft.setTextColor(ST77XX_WHITE);
  tft.setTextSize(3);
 

  /* Display the results (acceleration is measured in m/s^2) */
  tft.print("X: "); tft.print(event.acceleration.x); tft.println("  ");
  tft.setTextColor(ST77XX_GREEN);
  tft.print("Y: "); tft.print(event.acceleration.y); tft.println("  ");
  tft.setTextColor(ST77XX_RED);
  tft.print("Z: "); tft.print(event.acceleration.z); tft.println("  ");//tft.print("m/s^2 ");
  delay(50);

      // Display the time
      tft.setTextColor(ST77XX_CYAN);
      tft.print(clock1.getHour(h12Flag, pmFlag), DEC);
      tft.print(":");
      tft.print(clock1.getMinute(), DEC);
      tft.print(":");
      tft.println(clock1.getSecond(), DEC);

 
  /* Display the results (acceleration is measured in m/s^2) */
  //Serial.print("X: "); Serial.print(event.acceleration.x); Serial.print("  ");
  //Serial.print("Y: "); Serial.print(event.acceleration.y); Serial.print("  ");
  //Serial.print("Z: "); Serial.print(event.acceleration.z); Serial.print("  ");Serial.println("m/s^2 ");
  //delay(25);

  int rawValue = analogRead(ADC_pin);
  float voltageLevel = (rawValue / 8000.0) * 2 * 1.1 * 3.3; // calculate voltage level
  float batteryFraction = voltageLevel / MAX_BATTERY_VOLTAGE;
  tft.setTextColor(ST77XX_WHITE);
  tft.setTextSize(2);


  checkVoltage();
  tft.println((String)"V:" + vout);
  
  /*
  tft.println((String)"Raw:" + rawValue);
  tft.println((String)"Voltage:" + voltageLevel);
  tft.println((String)"" + (batteryFraction * 100) + "%");
  */

  delay(5000); 

}


void trotteuse(void){
  // We check the seconds
  int secon2;
  secon2 = clock1.getSecond();
  // Routine to display the seconds in a graphic mode
  int interv = secon2 *2;
  // Draw small rectangles on the left , starting at Y=140 finishing  void fillRect(uint16_t x0, uint16_t y0, uint16_t w, uint16_t h, uint16_t color)
  tft.fillRect(5, 130-(secon2*2)+1, 25, 1, 0x0000);
  tft.fillRect(5, 190 +(secon2*2)+1, 25, 1, ST77XX_GREEN);


  
  };
